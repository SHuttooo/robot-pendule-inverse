/* =====================================================================
   POLITIQUE APPRISE PAR RENFORCEMENT -- GENERE PAR 11_export_c.py
   NE PAS EDITER A LA MAIN.

   agent    : agents/balancier_final.zip
   reseau   : 15 -> 32 -> 32 -> 2,  activation tanh,  1634 poids
   flash    : 6536 octets de constantes
   cadence  : la politique decide a 100 Hz, l integrateur reste a 200 Hz

   ---------------------------------------------------------------------
   USAGE, dans robot_balancier.ino

     #include "politique.h"

     // dans resetLoops() :
         politique_reset();

     // dans innerLoop(), a la place du calcul de accel :
         static bool tickPol = false;
         static float accelPol = 0.0f;
         tickPol = !tickPol;
         if (tickPol) {                       // 100 Hz : un tick sur deux
           accelPol = politique_accel(pitch - angleOffset, gyroFilt,
                                      wheel_sps, stepCount, target_speed_sps,
                                      millis());
           if (politique_defaut != POL_OK) { ... voir INTEGRATION.md }
         }
         float accel = accelPol;

   Le reste de innerLoop() ne change pas : la limite d acceleration deratee,
   l integration, l anti-emballement et applyMotorSpeed() restent en place.

   ---------------------------------------------------------------------
   CONVENTIONS -- a verifier sur la carte AVANT de le laisser debout

     angle   pitch - angleOffset, en DEGRES, positif = penche vers l AVANT
     gyro    gyroFilt, en deg/s, meme signe que la derivee de l angle
     sps     wheel_sps, la vitesse commandee en pas/s
     pas     stepCount, l odometrie en pas
     cible   target_speed_sps, la consigne de vitesse en pas/s

   Le signe de l angle est le point critique du transfert : s il est
   inverse, le robot part par terre en une demi-seconde. Le protocole de
   verification est dans firmware/INTEGRATION.md.
   ===================================================================== */

#ifndef POLITIQUE_H
#define POLITIQUE_H

#include <math.h>

#define POL_N_OBS   15
#define POL_N_CACHE 32
#define POL_N_ACT    2

/* --- grandeurs physiques, doivent correspondre a modele.py ------------- */
#define POL_RAD_PAR_PAS  (2.0f * 3.14159265358979f / 1600.0f)
#define POL_RAYON_ROUE   0.032500f        /* m */
#define POL_MAX_ACCEL    25000.0f     /* pas/s2, pleine echelle de l action */
#define POL_V_MAX        0.1500f         /* m/s, pleine echelle de la consigne */
#define POL_DT_POL       0.01f               /* s, periode de la politique */

/* --- garde-fous, tous CHIFFRES en simulation -------------------------------
   POL_ANGLE_MAX  au-dela de 11 deg l agent ne se rattrape plus JAMAIS
                  (mesure : 6/6 rattrapes a 10 deg, 0/6 a 12 deg, laches
                  immobiles). Ton FALL_LIMIT de 30 deg le laisse donc
                  s acharner 19 deg apres que c est perdu. Ici on coupe tot.
   POL_SAT_MS     en marche normale l action ne sature JAMAIS : 0,0 % du temps
                  a |a| > 0,98, meme tres perturbe. Une saturation qui dure
                  est donc une anomalie franche, sans faux positif.
   Le test NaN    n est pas une precaution de principe : aucune comparaison
                  avec NaN n etant vraie, un NaN traverse EN SILENCE le
                  "if (a < MIN_SPS)" et le "if (a > lim)" de applyMotorSpeed,
                  et (uint32_t)(500000.0f/NaN) finit borne a 20 us de
                  demi-periode -- les moteurs partent a 25 000 pas/s.       */
#define POL_ANGLE_MAX    14.0f   /* deg, marge sur les 11 mesures */
#define POL_SAT_MS         120   /* ms de saturation continue tolerees */
#define POL_SAT_SEUIL    0.98f

enum {
  POL_OK = 0,
  POL_DEFAUT_ANGLE,      /* hors du domaine ou il sait se rattraper */
  POL_DEFAUT_SATURE,     /* commande collee a la butee trop longtemps */
  POL_DEFAUT_NAN         /* sortie non numerique */
};

static const float pol_w0[32][15] = {
  -4.16262835e-01f, -2.24071890e-01f, 2.21389785e-01f, -2.85731077e-01f, -2.54564345e-01f, -1.27662390e-01f,
  2.00622641e-02f, -1.21444754e-01f, 3.30124348e-01f, 1.11530267e-01f, -8.05416107e-02f, -2.24858940e-01f,
  -3.71496588e-01f, 2.96957433e-01f, 1.46932274e-01f, -8.59907120e-02f, -6.01947308e-01f, -3.04361761e-01f,
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  2.00815529e-01f, -2.00920418e-01f, -8.19289610e-02f, 7.26237372e-02f, -8.49171579e-02f, 1.76292029e-04f,
};
static const float pol_b0[32] = {
  3.01626232e-02f, 6.05097739e-03f, -2.23701578e-02f, -1.43201165e-02f, 2.21425798e-02f, 4.80641127e-02f,
  4.94310819e-02f, 4.06235121e-02f, 3.56896734e-03f, -3.62770073e-02f, 3.28252539e-02f, 8.03152397e-02f,
  9.94535070e-03f, -1.87698379e-02f, 1.67042599e-03f, -1.23885497e-02f, 9.46922787e-03f, 4.97122407e-02f,
  1.16362516e-02f, 7.67210964e-03f, 4.66250442e-03f, -3.92152667e-02f, -3.78465764e-02f, -1.27371484e-02f,
  -2.66730618e-02f, -1.45111540e-02f, 5.31228147e-02f, -2.07175296e-02f, -1.90580301e-02f, -4.07611616e-02f,
  6.17574863e-02f, 4.93687205e-03f,
};

static const float pol_w1[32][32] = {
  -4.95623857e-01f, -5.26375324e-02f, 2.40984902e-01f, -5.05373478e-01f, 8.13052133e-02f, 1.47175863e-01f,
  -1.01350754e-01f, 2.72854656e-01f, -1.85945824e-01f, 6.90722466e-02f, 1.91533148e-01f, 2.49940664e-01f,
  1.02248304e-01f, -6.17078766e-02f, -2.74767987e-02f, -1.87998578e-01f, 3.06692153e-01f, 3.78953695e-01f,
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  4.11283314e-01f, -3.40980023e-01f, -2.87559271e-01f, -4.00884390e-01f,
};
static const float pol_b1[32] = {
  -5.99509571e-04f, -8.69662315e-03f, 1.10001616e-01f, 3.98788750e-02f, 7.00768549e-03f, 3.72581296e-02f,
  -4.96796966e-02f, -1.81665123e-02f, -1.06936377e-02f, 2.73142997e-02f, 1.77415961e-03f, -1.29410364e-02f,
  1.25295622e-02f, -2.69591296e-03f, -1.38680974e-03f, -2.05881484e-02f, -4.75496193e-03f, 5.05201109e-02f,
  2.44895257e-02f, 5.36624119e-02f, 5.28515428e-02f, 3.15604769e-02f, -3.21605466e-02f, 2.49527488e-03f,
  -1.68771986e-02f, -8.89980420e-03f, 2.52322070e-02f, 6.46712352e-03f, -1.52830426e-02f, -3.02827498e-03f,
  -9.57452785e-03f, -2.55241198e-03f,
};

static const float pol_w2[2][32] = {
  -3.23578976e-02f, 6.85789734e-02f, 1.13745108e-01f, 6.71987236e-02f, -7.26746721e-03f, 8.14432837e-03f,
  -8.25709850e-03f, 2.64510363e-02f, 3.31559420e-01f, -1.41764786e-02f, -4.32741493e-02f, -1.38581842e-02f,
  -1.36060556e-02f, -3.73579204e-01f, -9.48270259e-04f, -3.10018798e-03f, 9.47442651e-02f, 3.96475494e-02f,
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  -7.71158338e-02f, -9.81654525e-02f, 4.14139181e-02f, -6.25878349e-02f,
};
static const float pol_b2[2] = {
  -9.46773775e-03f, 1.35084381e-02f,
};


/* ===================================================== etat de la politique */
static float pol_x_cible   = 0.0f;   /* integrale de la consigne, en metres  */
static float pol_a_prec[2]  = {0.0f, 0.0f};
static float pol_a_prec2[2] = {0.0f, 0.0f};
static unsigned long pol_sat_depuis = 0;   /* date du debut de saturation */

int politique_defaut = POL_OK;       /* a tester APRES chaque appel */

/* A APPELER A CHAQUE ARMEMENT, depuis resetLoops().
   Sans cela l agent repart avec l action qui precedait la chute et une
   cible de position periemee : il corrige une erreur qui n existe plus.
   C est le meme piege que les echeances en date absolue apres un reset. */
void politique_reset(void) {
  pol_x_cible = 0.0f;
  pol_a_prec[0]  = pol_a_prec[1]  = 0.0f;
  pol_a_prec2[0] = pol_a_prec2[1] = 0.0f;
  pol_sat_depuis = 0;
  politique_defaut = POL_OK;
}

/* Un flottant utilisable ? Ni NaN, ni infini. Ecrit sans isnan() pour ne
   dependre d aucune option de compilation : x != x n est vrai que pour NaN. */
static inline int pol_fini(float x) {
  return (x == x) && (x < 1e30f) && (x > -1e30f);
}

/* tanh de la bibliotheque. Exact, mais ~1 a 2 us par appel sur ESP32
   (newlib, pas d instruction materielle) : 64 appels par pas de politique.
   Si le chronometrage sur la carte le demande, regenerer avec --tanh-rapide. */
static inline float pol_tanh(float x) { return tanhf(x); }

static inline float pol_borne(float v, float lo, float hi) {
  return (v < lo) ? lo : ((v > hi) ? hi : v);
}

/* ============================================================== inference
   Deux couches cachees de 32, activation tanh, puis la couche de sortie.
   1 568 multiplications-accumulations et 64 tanh par appel.               */
static void pol_avant(const float obs[POL_N_OBS], float act[POL_N_ACT]) {
  float h0[POL_N_CACHE], h1[POL_N_CACHE];
  int i, j;

  for (i = 0; i < POL_N_CACHE; i++) {
    float s = pol_b0[i];
    for (j = 0; j < POL_N_OBS; j++) s += pol_w0[i][j] * obs[j];
    h0[i] = pol_tanh(s);
  }
  for (i = 0; i < POL_N_CACHE; i++) {
    float s = pol_b1[i];
    for (j = 0; j < POL_N_CACHE; j++) s += pol_w1[i][j] * h0[j];
    h1[i] = pol_tanh(s);
  }
  for (i = 0; i < POL_N_ACT; i++) {
    float s = pol_b2[i];
    for (j = 0; j < POL_N_CACHE; j++) s += pol_w2[i][j] * h1[j];
    act[i] = pol_borne(s, -1.0f, 1.0f);
  }
}

/* ==================================================== construire l observation
   Uniquement ce que le robot mesure. Les trois entrees indisponibles --
   gyro de lacet, ecart de cap, consigne de lacet -- sont a zero : mesure en
   simulation, ca ne change rien (survie 100 %, erreur 0,085 contre 0,086 deg).

   L entree 5, l ecart de position, est SATUREE a +-1,75. Sans cette borne une
   derive accumulee sort du domaine vu a l entrainement et le reseau extrapole
   n importe quoi -- il se jette par terre. C est le meme probleme que MAX_LEAD
   resout dans la cascade.                                                    */
void politique_observation(float angle_deg, float gyro_deg_s, float sps,
                           long pas, float cible_sps, float obs[POL_N_OBS]) {
  float odo = (float)pas * POL_RAD_PAR_PAS * POL_RAYON_ROUE;   /* metres */
  float cons_v = cible_sps * POL_RAD_PAR_PAS * POL_RAYON_ROUE; /* m/s    */
  int k;

  pol_x_cible += cons_v * POL_DT_POL;

  obs[0]  = angle_deg / 10.0f;
  obs[1]  = gyro_deg_s / 100.0f;
  obs[2]  = 0.0f;                       /* gyro de lacet : pas lu par le firmware */
  obs[3]  = sps / 1600.0f;
  obs[4]  = sps / 1600.0f;              /* un seul timer : les deux roues liees   */
  obs[5]  = pol_borne((odo - pol_x_cible) / 0.20f, -1.75f, 1.75f);
  obs[6]  = 0.0f;                       /* ecart de cap : pas d odometrie par roue */
  obs[7]  = cons_v / POL_V_MAX;
  obs[8]  = 0.0f;                       /* consigne de lacet */
  obs[9]  = pol_a_prec[0];
  obs[10] = pol_a_prec[1];
  obs[11] = pol_a_prec2[0];
  obs[12] = pol_a_prec2[1];
  obs[13] = sinf(angle_deg * 0.01745329252f);
  obs[14] = cosf(angle_deg * 0.01745329252f);

  /* filet general : le reseau n extrapole pas, on lui garantit qu il ne
     verra jamais rien d inconnu. */
  for (k = 0; k < POL_N_OBS; k++) obs[k] = pol_borne(obs[k], -6.0f, 6.0f);
}

/* ====================================================== l appel de haut niveau
   Retourne une acceleration de roue en pas/s2, a integrer exactement comme
   la sortie de la cascade.                                                   */
float politique_accel(float angle_deg, float gyro_deg_s, float sps,
                      long pas, float cible_sps, unsigned long ms) {
  float obs[POL_N_OBS], act[POL_N_ACT], moy;

  /* --- garde-fou amont : une entree non numerique ne doit jamais atteindre
     le reseau, elle en ressortirait en NaN et traverserait tout le firmware */
  if (!pol_fini(angle_deg) || !pol_fini(gyro_deg_s) || !pol_fini(sps)) {
    politique_defaut = POL_DEFAUT_NAN;
    return 0.0f;
  }

  /* --- garde-fou d angle : au-dela il ne se rattrape plus, inutile d essayer */
  if (angle_deg > POL_ANGLE_MAX || angle_deg < -POL_ANGLE_MAX) {
    politique_defaut = POL_DEFAUT_ANGLE;
    return 0.0f;
  }

  politique_observation(angle_deg, gyro_deg_s, sps, pas, cible_sps, obs);
  pol_avant(obs, act);

  /* --- garde-fou aval */
  if (!pol_fini(act[0]) || !pol_fini(act[1])) {
    politique_defaut = POL_DEFAUT_NAN;
    return 0.0f;
  }

  pol_a_prec2[0] = pol_a_prec[0];
  pol_a_prec2[1] = pol_a_prec[1];
  pol_a_prec[0]  = act[0];
  pol_a_prec[1]  = act[1];

  /* un seul timer : on moyenne les deux roues */
  moy = 0.5f * (act[0] + act[1]);

  if (moy > POL_SAT_SEUIL || moy < -POL_SAT_SEUIL) {
    if (pol_sat_depuis == 0) pol_sat_depuis = ms;
    else if (ms - pol_sat_depuis > POL_SAT_MS) politique_defaut = POL_DEFAUT_SATURE;
  } else {
    pol_sat_depuis = 0;
  }

  return moy * POL_MAX_ACCEL;
}

#endif /* POLITIQUE_H */
